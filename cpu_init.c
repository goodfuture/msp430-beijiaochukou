//#define  OS_CPU_GLOBALS
#include    <msp430xG46x.h>
#include "test.h"

#ifndef NULL
#define NULL 0
#endif

#define nop() asm("NOP")
typedef  int (INIT_FUNC)(void);

/* Table of CRC values for high-order byte */

const INT8U auchCRCHi[] = {
0x00, 0xC1, 0x81, 0x40, 0x01, 0xC0, 0x80, 0x41, 0x01, 0xC0,
0x80, 0x41, 0x00, 0xC1, 0x81, 0x40, 0x01, 0xC0, 0x80, 0x41,
0x00, 0xC1, 0x81, 0x40, 0x00, 0xC1, 0x81, 0x40, 0x01, 0xC0,
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0x80, 0x41, 0x00, 0xC1, 0x81, 0x40
} ;

/* Table of CRC values for low-order byte */

const INT8U auchCRCLo[] = {
0x00, 0xC0, 0xC1, 0x01, 0xC3, 0x03, 0x02, 0xC2, 0xC6, 0x06,
0x07, 0xC7, 0x05, 0xC5, 0xC4, 0x04, 0xCC, 0x0C, 0x0D, 0xCD,
0x0F, 0xCF, 0xCE, 0x0E, 0x0A, 0xCA, 0xCB, 0x0B, 0xC9, 0x09,
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0x43, 0x83, 0x41, 0x81, 0x80, 0x40
} ;
/*
int SCLK_init(void)
{
   volatile INT16U i;
  _BIS_SR(OSCOFF);   //turn off DCO and FLL+
   SCFQCTL=4;
  SCFQCTL   &=~SCFQ_M; //enable modulation
  nop();
  SCFI0   |=FN_8+FLLD_1;  //DCO range fDCOCLK =   1.4-12MHz
  //nop();
  FLL_CTL0    |= XCAP18PF;  //XIN Cap = XOUT Cap = 18pf
  nop();
 // FLL_CTL1    |=FLL_DIV_8;   // ALCK/8
  nop();
  FLL_CTL1    &=~XT2OFF; //turn on xt2  fxt2=8M
  nop();
  //FLL_CTL1

  do  //wait for stability
  {
    IFG1  &=~OFIFG;   //clear oscillator fault flag
    for(i=0;i<5000;i++);
  }while((IFG1&OFIFG));
  nop();
  FLL_CTL1    |=SELM1;
  FLL_CTL1    |=SELM_DCO+SELS;   //select XT2 as the MCLK and SMCLK
  nop();
  return(0);
}*/

int SCLK_init(void)
{
  volatile INT16U i;
  _BIS_SR(SCG0+OSCOFF+SCG1);   //turn off DCO and FLL+
  //SCFQCTL   &=~SCFQ_M; //enable modulation
  nop();
  //SCFI0   |=FN_4+FLLD_1;  //DCO range fDCOCLK =   1.4-12MHz
  //nop();
  //FLL_CTL0    |= XCAP18PF;  //XIN Cap = XOUT Cap = 18pf
  nop();
 // FLL_CTL1    |=FLL_DIV_8;   // ALCK/8
  nop();
  FLL_CTL1    &=~XT2OFF; //turn on xt2  fxt2=8M

  do  //wait for stability
  {
    IFG1  &=~OFIFG;   //clear oscillator fault flag
    for(i=0;i<5000;i++);
  }while((IFG1&OFIFG));
  nop();
 // FLL_CTL1    |=0X80; //LF1 digital clock input selecte
  FLL_CTL1    |=SELM1;
  nop();
  FLL_CTL1    |=SELM_XT2+SELS;   //select XT2 as the MCLK and SMCLK
  nop();
  return(0);
}

int IO_init(void)
{
  //unused io pins  should be configured as io function and output mode
#ifdef MAINBOARD
  //P1
  P1DIR |=BIT0+BIT1+BIT2+BIT3+BIT4+BIT5;  //p1.0,1.2,1.3,1.5,1.6 are output
//  P1IE  |=BIT6;            //enable p1.1,p1.4 interrupt
  P1IES |=0x40;                 //interrupt when high-to-low
  P1IFG &=0x00;                 //clear interrupt flags
  //P2
  P2DIR |=BIT0+BIT1+BIT4+BIT5+BIT6;
//  P2IE  |=BIT2;
  P2IES |=0x04;
  P2IFG &=0x00;
  //P3  p3.3 unused
  P3SEL |=BIT1+BIT2;                 //p3 are used as io pins p3.1,p3.2 I2C
  P3DIR |=BIT0+BIT4+BIT5+BIT6;
  //P4  P4.2 unused
  P4SEL |=BIT3+BIT4+BIT5+BIT6+BIT7; //P4.3,4,5 are used as SPI,uart
  P4DIR |=BIT2;      //P4.2,3,5,6 are output
  //P5  P5.0,1,2,3,4 unused
  P5DIR |=BIT2+BIT3;
  //P9
  P9DIR |=BIT4+BIT5;
  //P10
  P10DIR |=0xff;
#else
  //p2
  P2DIR |=BIT0+BIT3+BIT4+BIT5;
  P2IE  |=BIT2+BIT1;
  P2IES |=0x06;
  P2IFG &=0x00;
  //P3
  P3SEL |=BIT1+BIT2;                 //p3 are used as io pins p3.1,p3.2 I2C
  P3DIR |=BIT0+BIT4+BIT5+BIT6+BIT7;
  //p4
  P4SEL |=BIT3+BIT4+BIT5+BIT6+BIT7; //P4.3,4,5 are used as SPI,uart
  P4DIR |=BIT0+BIT1+BIT2;
  //P5
  P5DIR |=BIT0+BIT2+BIT3+BIT4+BIT5+BIT6+BIT7;//P5.6 UNUSED
  //p6
  P6SEL|=0xff;  //used as analog input
  //P7
  P7DIR |=BIT0+BIT1+BIT2+BIT3+BIT4+BIT5+BIT6+BIT7; //P7.0,2,5,6,7UNUSED
  //P8
  P8DIR |=BIT6+BIT7;  //P8.6,7 UNUSED
  //p9
  P9DIR |=0xff; //P9.0,1 UNUSED
  P10DIR |=0XFF;
#endif  //end MAINBOARD

  return(0);
}

int UART_init(void)
{
  //SPI 8bit master
  U1CTL |=SWRST;
  nop();
  U1CTL |=CHAR+SYNC+MM; //8-bit master spi mode
  U1TCTL  |=SSEL1+STC+CKPH;    //baud rate generated by SMCLK(8M)
  U1BR0 =0X02;//0x04;        //BAUD RATE =SMCLK/8   1Mhz?
  U1BR1 =0x00;
  U1MCTL  =0x00;
  ME2 |=USPIE1;
  U1CTL &=~SWRST;
  IFG2  &=~(UTXIFG1+URXIFG1); //clear interrupt flags

  //UART 8N1
  UCA0CTL1  |= UCSWRST;
  nop();
  UCA0CTL1  |=UCSSEL1;  //baud rate generated by SMCLK(8M)
  //UCA0CTL0  |=UCMSB;    //MSB first, uart mode, 8N1

  /*baud rate=9600 (BR0,BR1)=(0x41,0x03)  UCBRSX=0X02     **
  **baud rate=57600  (BR0,BR1)=(0X8A,0X00)  UCBRSX=0X07   **
  **baud rate=1M    (BR0,BR1)=(0X08,0X00)   UCBRSX=0X00   **
  */
  UCA0BR0 =0x41;  //N=SMCLK/BAUD  UCA0BR0+UCA0BR1*256=INT(N)
  UCA0BR1 =0x03;
  UCA0MCTL  =0x02;      //modulation  UCBRSX=round((N-int(N)*8))
//
  IFG2  &=~UCA0RXIFG;
  UCA0CTL1  &= ~UCSWRST;
  IE2 |=UCA0RXIE;     //enable receive interrupt
  //I2C   7-bit address master mode
  UCB0CTL1  |=UCSWRST;
  UCB0CTL0  |=UCMODE_3+UCSYNC+UCMST; //I2C master sync mode
  UCB0CTL1  |=UCSSEL_2;  //clock source SMCLK
  UCB0I2CSA =0x50;    //slave address is 0x50 AT24C256
  UCB0BR0   =0x19;//0x14;//0xa0;//100K//0x14;        //fclk=SMCLK/20=400K
  UCB0BR1   =0x00;
  UCB0CTL1  &=~UCSWRST;
  IFG2  &=~UCB0RXIFG;
  //UCB0I2CSA =0X50;
  return(0);

}

int DMA_init(void)
{
  return(0);
}

int ADC_init(void)
{
  ADC12CTL0|=SHT10+MSC+REF2_5V+REFON+ADC12ON;
  ADC12CTL1|=SHP+ADC12DIV_3+CONSEQ_3;

  ADC12MCTL0|=SREF_1+INCH_0;
  ADC12MCTL1|=SREF_1+INCH_0;
  ADC12MCTL2|=SREF_1+INCH_1;
  ADC12MCTL3|=SREF_1+INCH_1;
  ADC12MCTL4|=SREF_1+INCH_2;
  ADC12MCTL5|=SREF_1+INCH_2;
  ADC12MCTL6|=SREF_1+INCH_3;
  ADC12MCTL7|=SREF_1+INCH_3;
  ADC12MCTL8|=SREF_1+INCH_4;
  ADC12MCTL9|=SREF_1+INCH_4;
  ADC12MCTL10|=SREF_1+INCH_5;
  ADC12MCTL11|=SREF_1+INCH_5;
  ADC12MCTL12|=SREF_1+INCH_6;
  ADC12MCTL13|=SREF_1+INCH_6;
  ADC12MCTL14|=SREF_1+INCH_7;
  ADC12MCTL15|=SREF_1+INCH_7+EOS;
  ADC12IE =0X8000;
  ADC12CTL0|=ENC+ADC12SC;
  return(0);
}

int TIME_init(void)
{
  //Watch Dog  used as interval timer
  //WDTCTL  =WDT_ARST_1000+WDTTMSEL;  //interval=32768/32768=1
  WDTCTL  =WDTPW+WDTTMSEL+WDTCNTCL;
  IE1 |=WDTIE;
  IFG1  &=~WDTIFG;
  return(0);
}

int DAC_init(void)
{
  DAC12_0CTL|=DAC12OPS+DAC12AMP_5+DAC12ENC;
  DAC12_1CTL|=DAC12OPS+DAC12AMP_5+DAC12ENC;
  return(0);
}

INIT_FUNC  *pinit_func_sequence[]={
              SCLK_init,
              IO_init,
              //TIME_init,
              UART_init,
              DMA_init,
              ADC_init,
              DAC_init,
              NULL
};
/*
int CPU_init(void)
{
  INIT_FUNC **pinit_func;
  _BIS_SR(GIE);   //GIE =0 disable interrupt
  nop();
  WDTCTL  =WDTPW+WDTHOLD; //turn off watchdog
  nop();
  for(pinit_func=pinit_func_sequence;*pinit_func!=NULL;pinit_func++)
  {
    (*pinit_func)();
  }
  return(0);
}*/

int CPU_init(void)
{
  _BIC_SR(GIE);   //GIE =0 disable interrupt
  nop();
  WDTCTL  =WDTPW+WDTHOLD+WDTTMSEL; //turn off watchdog
  nop();
  SCLK_init();
  IO_init();
  UART_init();
  ADC_init();
  //DAC_init();
  TIME_init();
  //WDTCTL  =(WDTCTL&(~WDTHOLD))&0x00ff+WDTPW;
  return(0);
}

void MemoryClear(void *pdes,INT16U size)
{
  INT8U *temp;
  temp  =(INT8U *)pdes;
    while (size > 0) {
        *temp++ = (INT8U)0;
        size--;
    }
}
void MemoryCopy(INT8U *src,INT8U *des,INT16U len)
{
  while(len--)
  {
    *des++  =*src++;
  }
}

void CRC_Calculation_B(INT8U *src,INT16U len,INT8U *des)
{
  //unsigned char i;
	INT16U j;
	INT16U uIndex ;	/* will index into CRC lookup table*/

	//cc.CRC_HL=0xffff;
  *des  =0xff;
  *(des+1)  =0xff;
			
	for(j=0;j<len;j++)
	{
		uIndex = *des ^ *src++ ; /* calculate the CRC */
		(*des) = *(des+1) ^ auchCRCHi[uIndex] ;
		*(des+1) = auchCRCLo[uIndex] ;
	}
	
}

void CRC_Calculation(INT8U *src,INT16U len,INT8U *des)
{
  INT16U i,j;
  INT8U tmp;
  union{
    INT8U CRC[2];
    INT16U CRC_HL;
  }cc;
  cc.CRC_HL =0xffff;
  for(i=0;i<len;i++)
  {
    cc.CRC[1]^=*src++;
    for(j=0;j<8;j++)
    {
      tmp =cc.CRC[0]&0x01;
      cc.CRC_HL =cc.CRC_HL>>1;
      if(tmp==0x01)
        cc.CRC_HL^=0xa001;
    }
  }
  *des  =cc.CRC[0];
  *(des+1)  =cc.CRC[1];
}

INT8U StrToASCII(INT8U *src,INT8U *des,INT16U len)
{
  INT16U j;
  INT8U i;
  for(j=0;j<len;j++)
	{
		i=((*src)>>4)&0xf;
		if(i<=9)
			*des=i|0x30;
		else
			*des=i+0x37;
		i=(*src)&0xf;
		if(i<=9)
			*(des+1)=i|0x30;
		else
			*(des+1)=i+0x37;
    src++;
    des+=2;
	}
  return(0);
}

